## boards/arm/nrf52_keyfob/Kconfig.board
```kconfig
# Sparkfun nRF52832 breakout board configuration

# Copyright (c) 2022 Maximilian Deubel
# SPDX-License-Identifier: Apache-2.0

config BOARD_NRF52_KEYFOB
	bool "nRF52 KEYFOB"
	depends on SOC_NRF52832_QFAA
```

## boards/arm/nrf52_keyfob/Kconfig.defconfig
```kconfig
# Sparkfun nRF52832 breakout  board configuration

# Copyright (c) 2022 Maximilian Deubel
# SPDX-License-Identifier: Apache-2.0

if BOARD_NRF52_SPARKFUN

config BOARD
	default "nrf52_keyfob"

config BT_CTLR
	default BT

endif # BOARD_NRF52_SPARKFUN
```

## boards/arm/nrf52_keyfob/nrf52_keyfob_defconfig
```kconfig
# SPDX-License-Identifier: Apache-2.0

CONFIG_SOC_SERIES_NRF52X=y
CONFIG_SOC_NRF52832_QFAA=y
CONFIG_BOARD_NRF52_KEYFOB=y

# Enable MPU
CONFIG_ARM_MPU=y

# enable GPIO
CONFIG_GPIO=y

CONFIG_PINCTRL=y
```

## drivers/sensor/kx022/Kconfig
```kconfig
# 3-Axis, +/-8g Digital Accelerometer

# Copyright (c) 2022 Maximilian Deubel
# SPDX-License-Identifier: Apache-2.0

menuconfig KX022
	bool "KX022 Three Axis I2C/SPI accelerometer"
	default y
	depends on DT_HAS_KIONIX_KX022_ENABLED
	select I2C if $(dt_compat_on_bus,$(DT_COMPAT_KIONIX_KX022),i2c)
	select SPI if $(dt_compat_on_bus,$(DT_COMPAT_KIONIX_KX022),spi)
	help
	  Enable driver for KX022 Three-Axis Digital Accelerometers.

if KX022

choice KX022_BUS_TYPE
	prompt "Interface type"
	default KX022_I2C if $(dt_compat_on_bus,$(DT_COMPAT_KIONIX_KX022),i2c)
	default KX022_SPI if $(dt_compat_on_bus,$(DT_COMPAT_KIONIX_KX022),spi)
	help
	  Select interface the digital interface type for the KX022

config KX022_I2C
	depends on I2C
	bool "I2C Interface"

config KX022_SPI
	depends on SPI
	bool "SPI Interface"

endchoice

endif # ADXL372
```

## dts/bindings/sensor/kionix,kx022-i2c.yaml
```yaml
# Copyright (c) 2022 Maximilian Deubel
# SPDX-License-Identifier: Apache-2.0

description: KX022/KX122 3-axis accelerometer

compatible: "kionix,kx022"

include: i2c-device.yaml

properties:
    int1-gpios:
      type: phandle-array
      required: false
      description: |
        The INT1 signal defaults to active high as produced by the
        sensor.  The property value should ensure the flags properly
        describe the signal that is presented to the driver.
    tilt-axis-mask:
      type: uint8-array
      default: [1,1,1,1,1,1]
      description:
        Choose which directions generate a tilt interrupt.
        Zero values disable the interrupts. Six values are needed (x-,x+,y-,y+,z-,z+).
    tilt-timer:
      type: uint8
      default: 0
        Zero values disable the interrupts. Six values are needed (x-,x+,y-,y+,z-,z+).
    motion-timer:
      type: uint8
      default: 0
    single-tap-detection:
      type: boolean
      default: false
      default: 0
    double-tap-detection:
      type: boolean
      default: false
```

## dts/bindings/sensor/kionix,kx022.yaml
```yaml
# Copyright (c) 2022 Maximilian Deubel
# SPDX-License-Identifier: Apache-2.0

description: KX022/KX122 3-axis accelerometer

compatible: "kionix,kx022"

include: i2c-device.yaml
```
