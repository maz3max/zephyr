## CMakeLists.txt
```
cmake_minimum_required(VERSION 3.20.0)

find_package(Zephyr REQUIRED HINTS $ENV{ZEPHYR_BASE})
project(kx022_test)

zephyr_library_include_directories(
        ${ZEPHYR_BASE}/drivers/sensor/kx022
)

FILE(GLOB app_sources src/*.c ${ZEPHYR_BASE}/drivers/sensor/kx022/kx022.c)

target_sources(app PRIVATE ${app_sources})
```

## Kconfig
```
# Bluetooth Controller configuration options for ISO-AL Unit Tests

# Copyright (c) 2022 Oticon A/S
# SPDX-License-Identifier: Apache-2.0

source "Kconfig.zephyr"
```

## prj.conf
```kconfig
CONFIG_ZTEST=y
CONFIG_ZTEST_NEW_API=y
CONFIG_ZTEST_ASSERT_VERBOSE=3
CONFIG_ZTEST_STACK_SIZE=4096

CONFIG_ZTEST_ASSERT_HOOK=y
CONFIG_SENSOR=y
```

## src/main.c
```c
#include <zephyr/fff.h>
#include <zephyr/types.h>
#include <zephyr/ztest.h>
#include <zephyr/ztest_error_hook.h>

#include "kx022.h"

DEFINE_FFF_GLOBALS;

/*
int kx022_bus_access(const struct device *dev, uint8_t reg,
			      void *data, size_t length)*/

FAKE_VALUE_FUNC(int, kx022_bus_access, const struct device *, uint8_t, void*, size_t);

static void common_before(void *f)
{
}

ZTEST(test_bus, test_init)
{
        kx022_init(NULL);
}

ZTEST_SUITE(test_bus, NULL, NULL, common_before, NULL, NULL);
```
